## workspace/open_rowing_monitor_esp32/module/RowingSettings/Kconfig
```kconfig
menu "Rowing Engine Physics"

config OPENROWING_IMPULSES_PER_REV
    int "Impulses per Revolution"
    default 1
    help
        Number of magnets on the flywheel.

config MIN_TIME_BETWEEN_IMPULSE_X10000
    int "Time duration between impulses (scaled x10000)"
    default 140
    help
        Minimum time duration between impulses.

config MAX_TIME_BETWEEN_IMPULSE_X10000
    int "Time duration between impulses (scaled x10000)"
    default 5000
    help
        Maximun time duration between impulses.

config MAXIMUM_DOWNWARD_CHANGE_X10000
    int "Percentage change between successive intervals before measurements are considered invalid (scaled x10000)"
    default 2500
    help
        Effectively the maximum acceleration.

config MAXIMUM_UPWARD_CHANGE_X10000
    int "Percentage change between successive intervals before measurements are considered invalid (scaled x10000)"
    default 17500
    help
        Effectively the maximum deceleration.

config SMOOTHING
    int "(scaled x10000)"
    default 10000
    help
        Smoothing determines the length of the running average for certain volatile measurements, 1 effectively turns it off

config FLANK_LENGTH
    int ""
    default 2
    help
        minimum number of consecutive increasing/decreasing measuments that are needed before the stroke detection considers a drive phase change

config NUM_OF_ERRORS_ALLOWED
    int ""
    default 0
    help
        Allows for a more noisy approach, but shouldn't be needed

config OPENROWING_FLYWHEEL_INERTIA_X10000
    int "Flywheel Inertia (scaled x10000)"
    default 600
    help
      The inertia of the flywheel. Value is divided by 10000 in code.
      Default 600 represents 0.06 kg*m^2.

config OPENROWING_MINIMUM_DRIVE_TIME_MS
    int "Minimum Drive Time (ms)"
    default 400
    help
      Shortest valid drive phase in milliseconds.

config OPENROWING_AUTO_DRAG_FACTOR
    bool "Enable Auto Drag Factor Adjustment"
    default y
    help
      If enabled, the engine calculates drag based on deceleration.

endmenu
```

## workspace/open_rowing_monitor_esp32/modules/hardware_driver/GpioTimerService/Kconfig
```kconfig
menu "GPIO Timer Service Configuration"

config PHYSICS_THREAD_STACK_SIZE
    int "Physics Thread Stack Size (bytes)"
    default 4096
    range 2048 16384
    help
        Stack size for the physics processing thread.
        This thread handles all rowing calculations triggered by magnet pulses.

        Increase this if you see stack overflow errors during long sessions.
        Monitor actual usage with CONFIG_THREAD_ANALYZER=y.

        Recommended values:
        - 2048: Minimal (may overflow during complex sessions)
        - 4096: Safe for typical usage
        - 6144: Extra headroom for debugging/profiling
        - 8192: Maximum safety margin

config ENABLE_PHYSICS_PROFILING
    bool "Enable Physics Thread Performance Profiling"
    default n
    help
        When enabled, the physics thread measures and logs:
        - Processing time per impulse
        - Maximum processing time
        - Average processing time

        This adds minimal overhead (~5 microseconds per impulse) but provides
        valuable debugging information.

        Disable for production to save CPU cycles.

endmenu
```

## workspace/open_rowing_monitor_esp32/modules/hardware_driver/InputTimerService/Kconfig
```kconfig
menu "Input Timer Service Configuration"

config INPUT_IMPULSE_QUEUE_SIZE
    int "Size of Message Queue between ISR and Physics thread"
    default 50
    help
        Size of the queue used by the ISR and the Physics thread.
        This queue will already be scaled in compile time depending on how many magnets are installed,
        as long as you updated CONFIG_ORM_IMPULSE_PER_REV.

        Only increase if you run into issues where the queue size isnt enough.

config INPUT_PHYSICS_THREAD_STACK_SIZE
    int "Physics Thread Stack Size (bytes)"
    default 4096
    range 2048 16384
    help
        Stack size for the physics processing thread.
        This thread handles all rowing calculations triggered by magnet pulses.

        Increase this if you see stack overflow errors during long sessions.
        Monitor actual usage with CONFIG_THREAD_ANALYZER=y.

        Recommended values:
        - 2048: Minimal (may overflow during complex sessions)
        - 4096: Safe for typical usage
        - 6144: Extra headroom for debugging/profiling
        - 8192: Maximum safety margin

config INPUT_ENABLE_PHYSICS_PROFILING
    bool "Enable Physics Thread Performance Profiling"
    default n
    help
        When enabled, the physics thread measures and logs:
        - Processing time per impulse
        - Maximum processing time
        - Average processing time

        This adds minimal overhead (~5 microseconds per impulse) but provides
        valuable debugging information.

        Disable for production to save CPU cycles.

endmenu
```

## workspace/open_rowing_monitor_esp32/modules/rowing_core/RowingSettings/Kconfig
```kconfig
menu "Rowing Engine Physics"

config ORM_IMPULSES_PER_REV
    int "Impulses per Revolution"
    default 1
    help
        The number of magnets on the flywheel.
        Most standard DIY builds use 1.

config ORM_MIN_TIME_BETWEEN_IMPULSE_X10000
    int "Min Time Between Impulses (x10000)"
    default 140
    help
        The shortest physically possible time between magnets in seconds (scaled x10000).
        Used to filter out sensor bounce (noise).
        Example: 140 = 0.014 seconds.

config ORM_MAX_TIME_BETWEEN_IMPULSE_X10000
    int "Max Time Between Impulses (x10000)"
    default 35000
    help
        The longest valid time between magnets in seconds (scaled x10000).
        If a pulse takes longer than this, it is treated as a pause/stop.
        Example: 35000 = 3.5 seconds.
        Note: Must be longer than your slowest recovery stroke.

config ORM_MAXIMUM_DOWNWARD_CHANGE_X10000
    int "Max Acceleration Change % (x10000)"
    default 2500
    help
        Maximum allowed acceleration between two magnet pulses (scaled x10000).
        Example: 2500 = 25% change allowed.
        If speed increases faster than this, it is ignored as noise.

config ORM_MAXIMUM_UPWARD_CHANGE_X10000
    int "Max Deceleration Change % (x10000)"
    default 17500
    help
        Maximum allowed deceleration between two magnet pulses (scaled x10000).
        Example: 17500 = 175% change allowed.
        If speed drops faster than this (e.g., hitting a wall), it is ignored as noise.

config ORM_SMOOTHING
    int "Smoothing Buffer Size"
    default 4
    range 1 20
    help
        Number of samples used for the moving average noise filter.
        Higher = smoother data but more lag.
        Lower = responsive but jerky.
        Typical range: 3-6.

config ORM_FLANK_LENGTH
    int "Flank Detection Length"
    default 4
    help
        Number of consecutive increasing/decreasing measurements required to confirm
        a phase change (Drive <-> Recovery).
        Increase this if you see "ghost strokes" during recovery.

config ORM_NUM_OF_ERRORS_ALLOWED
    int "Allowed Detection Errors"
    default 0
    help
        How many "wrong direction" samples are allowed within a flank before
        resetting detection. Keep at 0 unless sensor is very noisy.

config ORM_NATURAL_DECELARATION_X10000
    int "Natural Deceleration (x10000)"
    default 0
    help
        Expected deceleration of the flywheel when no force is applied (scaled x10000).
        Set to 0 to disable and rely solely on time comparisons.

config ORM_MAX_IMPULSE_TIME_BEFORE_PAUSE_X10000
    int "Pause Detection Time (x10000)"
    default 30000
    help
        Time in seconds (scaled x10000) after which the workout is considered Paused.
        Example: 30000 = 3.0 seconds.

config ORM_MIN_DRIVE_TIME_X10000
    int "Min Drive Duration (x10000)"
    default 3000
    help
        Minimum valid length of a drive phase in seconds (scaled x10000).
        Strokes shorter than this are ignored.
        Example: 3000 = 0.3 seconds.

config ORM_MIN_RECOVERY_TIME_X10000
    int "Min Recovery Duration (x10000)"
    default 12000
    help
        Minimum valid length of a recovery phase in seconds (scaled x10000).
        Example: 12000 = 1.2 seconds.

config ORM_FLYWHEEL_INERTIA_X10000
    int "Flywheel Inertia (x10000)"
    default 5000
    help
        Moment of Inertia in kg*m^2 (scaled x10000).
        CRITICAL for accurate Watt/Power calculations.
        Example: 5000 = 0.5 kg*m^2.
        (Note: Air rowers are usually ~600 (0.06), Magnetic rowers are higher).

config ORM_AUTO_ADJUST_DRAG_FACTOR
    bool "Enable Auto Drag Factor"
    default y
    help
        If enabled, the engine calculates drag dynamically based on deceleration.
        Highly recommended for magnetic/air rowers.

# Everything inside this 'if' block disappears if Auto Adjust is OFF
if ORM_AUTO_ADJUST_DRAG_FACTOR

config ORM_DAMPING_CONSTANT_SMOOTING
    int "Drag Factor Smoothing"
    default 5
    help
        Number of strokes to average the calculated drag factor over.
        Prevents Watts from jumping wildly between strokes.

config ORM_DAMPING_CONSTANT_MAX_CHANGE_X10000
    int "Max Drag Factor Change (x10000)"
    default 1000
    help
        Maximum allowed change in drag factor per update (scaled x10000).
        Example: 1000 = 10% change.

endif # ORM_AUTO_ADJUST_DRAG_FACTOR

config ORM_DRAG_FACTOR
    int "Initial/Static Drag Factor"
    default 1500
    help
        The Drag Coefficient (scaled x10000).
        If Auto Adjust is ON: This is the starting value before the first stroke.
        If Auto Adjust is OFF: This value is used constantly.

config ORM_MAGIC_CONSTANT_X10000
    int "Constant for computing distance (x10000)"
    default 2800
    help
        Magic constant (x10000)
        This is used to calculate the distnace based on power.

endmenu
```

## workspace/open_rowing_monitor_esp32/modules/utilities/PowerManager/Kconfig
```kconfig
menu "Power Management Configuration"

config POWER_INACTIVITY_TIMEOUT_MS
    int "Inactivity Timeout (milliseconds)"
    default 300000
    range 10000 3600000
    help
        Time in milliseconds before entering deep sleep when:
        - No BLE connections active
        - No rowing activity detected

        Default: 300000 ms (5 minutes)

        Recommended values:
        - 60000: 1 minute (aggressive power saving)
        - 300000: 5 minutes (balanced)
        - 600000: 10 minutes (conservative)

endmenu
```

## workspace/open_rowing_monitor_esp32/modules/utilities/SystemMonitor/Kconfig
```kconfig
menu "ORM System Monitor"

config SYSM_ENABLE_MONITORING
    bool "Enables system monitoring for debugging"
    default n
    help
        Use this to see threads stack sizes and total use of heap to help adjust
        CONFIG_MAIN_STACK_SIZE
        CONFIG_GPIO_PHYSICS_THREAD_STACK_SIZE
        CONFIG_HEAP_MEM_POOL_SIZE

endmenu
```
